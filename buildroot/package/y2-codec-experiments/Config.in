## buildroot/package/y2-codec-experiments/Config.in
```kconfig
config BR2_PACKAGE_Y2_CODEC_EXPERIMENTS
	bool "Y2 owner-private Bluetooth encoder qualification"
	depends on BR2_PACKAGE_BLUEZ_ALSA
	depends on BR2_PACKAGE_FDK_AAC_ARCH_SUPPORTS
	depends on BR2_INSTALL_LIBSTDCPP
	depends on !BR2_STATIC_LIBS
	select BR2_PACKAGE_FDK_AAC
	select BR2_PACKAGE_LIBFREEAPTX if BR2_PACKAGE_Y2_CODEC_APTX
	select BR2_PACKAGE_LIBLDAC
	help
	  Build AAC, aptX, aptX HD and LDAC for owner-private experiments.
	  Private integration images enable these endpoints experimentally.
	  SBC remains the bounded fallback. No public distribution approval
	  or physical qualification is implied; public packaging rejects this profile.

config BR2_PACKAGE_Y2_CODEC_APTX
	bool "aptX and aptX HD (owner-private builds only)"
	default y
	depends on BR2_PACKAGE_Y2_CODEC_EXPERIMENTS
	help
	  Build the aptX and aptX HD encoders (libfreeaptx). Public releases
	  turn this off (tools/production/build.py --public): owner decision
	  2026-10-16, Qualcomm's codecs are not distributed publicly.
```

## buildroot/package/y2-update/Config.in
```kconfig
config BR2_PACKAGE_Y2_UPDATE
	bool "Y2 signed full-system updater and recovery screen"
	select BR2_PACKAGE_LIBSODIUM
	select BR2_PACKAGE_JSON_C
	select BR2_PACKAGE_ZLIB
	select BR2_PACKAGE_LIBDRM
	help
	  Detached Ed25519 verification, RECOVERY/MISC requests from the normal
	  system and offline BOOTIMG + Y2ROOT backup/install/restore in the Y2
	  recovery image. No partition table, loader or protected writes.
```
